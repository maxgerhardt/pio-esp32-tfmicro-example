## sdkconfig.defaults
```kconfig
CONFIG_AUTOSTART_ARDUINO=y
# CONFIG_WS2812_LED_ENABLE is not set
CONFIG_FREERTOS_HZ=1000
CONFIG_MBEDTLS_PSK_MODES=y
CONFIG_MBEDTLS_KEY_EXCHANGE_PSK=y

#
# esp-nn
#
CONFIG_NN_ESP32=y

# allocate larger stack for test functions
CONFIG_ARDUINO_LOOP_STACK_SIZE=32768
```
